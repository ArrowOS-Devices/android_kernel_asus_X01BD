## drivers/input/fingerprint/Kconfig
```kconfig
#
# Fingerprint driver configuration
#

menuconfig INPUT_FINGERPRINT
	bool "Fingerprint"
	help
	  Say Y here, and a list of supported fingerprint will be displayed.
	  This option doesn't affect the kernel.

	  If unsure, say Y.

if INPUT_FINGERPRINT

config COMMON_FP
    bool "Fingerprint common"
	help
		Say Y here if you use common fp.
		If unsure, say N.

config CDFINGER_FP
    bool "Fingerprint cdfinger"
	help
		Say Y here if you use common fp.
		If unsure, say N.

# Huaqin add for ZQL1650-143 by wangxiang at 2018/02/09 start
config GOODIX_FP
    bool "Fingerprint goodix"
	help
		Say Y here if you use common fp.
		If unsure, say N.

# Huaqin add for ZQL1650-143 by wangxiang at 2018/02/09 end

# Huaqin add for ZQL1820-42 by puqirui at 2018/08/02 start
config FOCALTECH_FP
    bool "Fingerprint focaltech"
	help
		Say Y here if you use focaltech fp.
		If unsure, say N.

# Huaqin add for ZQL1820-42 by puqirui at 2018/08/02 end
endif
```

## drivers/platform/asus/Kconfig
```kconfig
# ASUS SDM660 configuration options
config MACH_ASUS
	bool "Asus device"
	depends on ARCH_QCOM
	help
	  Support for Asus products

config MACH_ASUS_SDM660
	bool "Asus SDM660"
	depends on ARCH_SDM660
	select MACH_ASUS
	help
	  Support for SDM660 Asus variants
menu "Asus board selection"

config MACH_X01BD
	bool "X01BD board"
	select MACH_ASUS_SDM660
	help
	  Support for Asus X01BD variant
endmenu
```

## drivers/sensors/Kconfig
```kconfig
config SENSORS_SSC
	bool "Enable Sensors Driver Support for SSC"
	help
	  Add support for sensors SSC driver.
	  This driver is used for exercising sensors use case,
	  time syncing with ADSP clock.
#Huaqin add for als/ps by zhuqiang at 2018/08/03 start
config INPUT_STK3335
	tristate "STK STK3335 alsps sensor"
	depends on I2C
	help
	  Say Y here to enable the STK3335 ALSPS Sensor.
#Huaqin add for als/ps by zhuqiang at 2018/08/03 end
```
